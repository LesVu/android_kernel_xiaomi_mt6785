## drivers/misc/mediatek/devapc/Kconfig
```kconfig
config MTK_DEVAPC
	bool "Mediatek Device APC Support"
	help
	  Device APC is a kernel driver controlling internal device security.
	  If someone tries to access a device, which is not allowed by the
	  device, it cannot access the device and will get a violation
	  interrupt. Device APC prevents malicious access to internal devices.

config DEVAPC_ARCH_V1
	bool "Mediatek Device APC driver architecture v1"
	help
	  Say yes here to enable support Mediatek
	  Device APC driver which is based on HW
	  architecture version 1.
	  This architecture supports 1 Infra AO.

config DEVAPC_MMAP_DEBUG
	bool "Mediatek Device APC memory map debug mode"
	help
	  Say yes here to enable support Mediatek
	  Device APC driver to debug violation
	  through catching illegal memory mapped
	  range.

config DEVAPC_SWP_SUPPORT
	bool "Mediatek Device APC software watchpoint support"
	help
	  Say yes here to enable support Mediatek
	  Device APC driver to debug violation
	  through software watchpoint.
	  Support read/write transaction separately.

config DEVAPC_MT6785
	bool "Mediatek MT6785 Device APC driver"
	depends on MACH_MT6785 || COMPILE_TEST
	select DEVAPC_ARCH_V1
	select MTK_DEVAPC
	select DEVAPC_MMAP_DEBUG
	select DEVAPC_SWP_SUPPORT if MTK_ENG_BUILD
	help
	  Say yes here to enable support Mediatek MT6785
	  Device APC driver.
	  This driver is combined with DEVAPC_ARCH_V1 for
	  common handle flow.
```

## drivers/misc/mediatek/devmpu/Kconfig
```kconfig
config MTK_DEVMPU
	bool "Enable MTK Device MPU driver"
	help
	  Device MPU is a kernel driver providing
	  non-continuous memory protection in the
	  2MB granularity. Note that the protection
	  is conducted in parallel with EMI MPU.

config MTK_DEVMPU_EMI
	bool "Enable MTK Device MPU with EMI MPU"
	select MTK_DEVMPU
	help
	  Device MPU hardware will receive the violation
	  from EMI MPU hardware. Device MPU driver will
	  receive violation via call-back function of
	  EMI MPU.

config MTK_DEVMPU_SLOG
	bool "Enable slog for Device MPU violation"
	depends on MTK_DEVMPU
	help
	  Say yes here to enable mtk slog. When Device
	  MPU violation occur, Device MPU driver will dump
	  violation info to slog, then slog system record
	  it and list as issue when offline parsing.
```

## drivers/misc/mediatek/leds/Kconfig
```kconfig
config MTK_LEDS
	tristate "MediaTek LED Support"
	depends on LEDS_CLASS
	---help---
	  This selects the MediaTek(R) LEDs connected to MediaTek chips.
	  If you want to use MediaTek(R) LEDs support, say Y or M here.
	  If unsure, say N.
	  Mediatek LED module includes backlight, indicate LED, keypad LED, button LED etc.

config LIGHTNESS_MAPPING_VALUE
	int "Backlight brightness mapping value"
	default 255
	---help---
	  Backlight brightness mapping value, from 0 to 255.

config LEDS_MTK_DISP
	tristate "Mediatek display LED support"
	depends on LEDS_CLASS
	---help---
	  This option enables support for Mediatek display LEDs.
	  say 'y' to enable this
          Set n to disable.
	  To compile this driver as a module, the module will be called leds-mtk-disp.

config LEDS_MTK_PWM
	tristate "Mediatek pwm LED support"
	depends on LEDS_CLASS
	depends on PWM_MTK_DISP
	help
	  This option enables support for Mediatek pwm LEDs.
	  say 'y' to enable this

	  To compile this driver as a module, choose 'M' here: the module
	  will be called leds-mtk-pwm.

config LEDS_MTK_I2C
	tristate "Mediatek i2c LED support"
	depends on LEDS_CLASS
	help
	  This option enables support for Mediatek i2c LEDs.
	  say 'y' to enable this

	  To compile this driver as a module, choose 'M' here: the module
	  will be called leds-mtk-i2c.
```

## drivers/misc/mediatek/pmic/Kconfig
```kconfig
#
# MTK PMIC configuration
#

config MTK_PMIC_NEW_ARCH
	tristate "MediaTek Power Management New Arch driver"
	default n
	---help---
	  This selects for MediaTek(R) PMIC New Arch driver.
	  Separate pmic feature form Power folder that also have battery and charging feature.
	  Select y to support MTK PMIC NEW ARCH.
	  If so, you should choose the corresponding main chip to follow.

	  Select n to support MTK PMIC LEGACY ARCH.

config MTK_PMIC_COMMON
	tristate "MediaTek Power Management Common driver"
	default n
	---help---
	  This selects for MediaTek(R) PMIC common driver.
	  This feature is mainly to separate to common and platform part from driver layer.
	  Select y to support MTK PMIC COMMON feature.
	  Set n and choose other chip.

config MTK_PMIC_CHIP_MT6359
	tristate "MediaTek PMIC MT6359 Driver"
	default n
	---help---
	  This selects for MediaTek(R) PMIC MT6359 driver.
	  It's main chip type and providing power features like auxadc,
	  buck/ldo, interrupt-controller..etc
	  Set y to support this driver.
	  Set n and choose other chip.

config MTK_PMIC_CHIP_MT6359P
	tristate "MediaTek PMIC MT6359P Driver"
	default n
	---help---
	  This selects for MediaTek(R) PMIC MT6359P driver.
	  It's main chip type and providing power features like auxadc,
	  buck/ldo, interrupt-controller..etc
	  Set y to support this driver.
	  Set n and choose other chip.

config MTK_AUXADC_INTF
	bool "MediaTek PMIC Auxadc interface"
	depends on MTK_PMIC_NEW_ARCH
	default n
	---help---
	  MediaTek PMIC Auxadc interface Driver
	  only for MTK_PMIC_NEW_ARCH
	  Set y to enable it.
	  Set n to disable it.

config MTK_EXTERNAL_CHARGER_TYPE_DETECT
	bool "MediaTek external charger type detection"
	depends on MTK_PMIC_NEW_ARCH
	default n
	---help---
	  MediaTek external charger type detection flow
	  only for MTK_PMIC_NEW_ARCH
	  It used to support external charger type detection.
	  Default is MTK PMIC path. Select Y to disable MTK charger type detect.
	  Set y to enable it.
	  Set n to disable it.

source "drivers/misc/mediatek/pmic/mt6360/Kconfig"
```
